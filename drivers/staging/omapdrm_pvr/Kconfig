## drivers/staging/omapdrm_pvr/Kconfig
```kconfig
menu "PowerVR SGX"

config DRM_OMAP_PVR
        tristate "OMAP PVR SGX Drivers"
	depends on DRM_OMAP && m
        default N
        ---help---
          Support SGX core with OMAP DRM driver

endmenu
```

## drivers/staging/sgx/Kconfig
```kconfig
menu "PowerVR SGX"

config PVR_SGX
        tristate "PVR SGX Drivers"
        default N
        ---help---
          Enable PVR SGX support

endmenu
```
